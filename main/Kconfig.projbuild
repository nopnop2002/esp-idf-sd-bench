## main/Kconfig.projbuild
```kconfig
menu "Application menu"

	choice INTERFACE
		prompt "Interface"
		default SDMMCE
		help
			Select Interface.
		config SDMMC
			bool "SDMMC Interface"
			help
				SDMMC Interface.
		config SDSPI
			bool "SPI Interface"
			help
				SDSPI Interface.
	endchoice

	config EXAMPLE_FORMAT_IF_MOUNT_FAILED
		bool "Format the card if mount failed"
		default n
		help
			If this config item is set, format_if_mount_failed will be set to true and the card will be formatted if
			the mount has failed.
endmenu
```
